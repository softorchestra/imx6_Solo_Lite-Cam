## sources/meta-idair/conf/layer.conf
```bitbake
# We have a conf and classes directory, append to BBPATH
BBPATH .= ":${LAYERDIR}"

# We have a recipes directory, add to BBFILES
BBFILES += "${LAYERDIR}/recipes*/*.bb ${LAYERDIR}/recipes*/*/*.bb ${LAYERDIR}/recipes*/*.bbappend"

BBFILE_COLLECTIONS += "meta-idair"
BBFILE_PATTERN_meta-idair := "^${LAYERDIR}/"
BBFILE_PRIORITY_meta-idair = "6"
```
